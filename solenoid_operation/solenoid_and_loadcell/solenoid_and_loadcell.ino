#include <HX711_ADC.h>
#if defined(ESP8266)|| defined(ESP32) || defined(AVR)
#include <EEPROM.h>
#endif

//pins:
const int HX711_dout = 3; //mcu > HX711 dout pin
const int HX711_sck = 5; //mcu > HX711 sck pin
const int solenoid_pin = 2;
const int open_button = 10;
const int close_button = 11;

//HX711 constructor:
HX711_ADC LoadCell(HX711_dout, HX711_sck);

const int calVal_eepromAdress = 0;
unsigned long t = 0;
float calibrationValue;
bool valve_state = false; //false == closed
int cycleNum = 0;



void setup() {

  pinMode(solenoid_pin, OUTPUT);
  pinMode(open_button, INPUT);
  pinMode(close_button, INPUT);

  Serial.begin(115200);
  Serial.println();

  LoadCell.begin();
  #if defined(ESP8266)|| defined(ESP32)
  #endif
  EEPROM.get(calVal_eepromAdress, calibrationValue);
  //LoadCell.setReverseOutput(); //Uncomment this if the load cell is mounted backwards

  unsigned long stabilizingtime = 2000; // preciscion right after power-up can be improved by adding a few seconds of stabilizing time
  boolean _tare = true; //set this to false if you don't want tare to be performed in the next step
  LoadCell.start(stabilizingtime, _tare);
  if (LoadCell.getTareTimeoutFlag()) {
    Serial.println("Timeout, check MCU>HX711 wiring and pin designations");
    while (1);
  }
  else {
    LoadCell.setCalFactor(calibrationValue); // set calibration value (float)
    Serial.println("Starting...");
    Serial.println("Starting...");
    Serial.println("Starting...");
    Serial.println("Starting...");
  }
}



void loop() {

  updateLoadCell(); // sends single value of load cell to single line in the Serial Monitor

  updateValveState(); // updates the boolean "valve_state" by checking buttons

  //Implement control logic for an open valve here
  if(valve_state == true)
  {
    pwmThrust(); // adjust the values for openGap and closedGap in pwmThrust() in order to adjust thrust percentage
  }

  checkTare();
}




void updateLoadCell(){
static boolean newDataReady = 0;
  const int serialPrintInterval = 0; //increase value to slow down serial print activity

  // check for new data/start next conversion:
  if (LoadCell.update()) newDataReady = true;

  // get smoothed value from the dataset:
  if (newDataReady) {
    if (millis() > t + serialPrintInterval) {
      float i = LoadCell.getData();
      Serial.println(i);
      newDataReady = 0;
      t = millis();
    }
  }
}

void updateValveState(){
if(digitalRead(open_button)==HIGH && valve_state == false)
  {
    valve_state = true;
  }
if(digitalRead(close_button)==HIGH && valve_state == true)
  {
    valve_state = false;
  }
}

void pwmThrust(){
  int timer;
  int openGap;
  int closeGap;
  while(digitalRead(close_button) == LOW) // this control logic could be simpler if I used delay(), but then you would have to hold the close button for longer. I just want to see if this method is feasible
  { 
    digitalWrite(solenoid_pin, HIGH);
    timer = millis();// reset the timer to the time when the valve is closed
    openGap = 0; // "openGap" represents the amout of time in milliseconds since the valve was opened
    while(openGap < 200 && digitalRead(close_button) == LOW) // make this number very large if you simply want the valve to stay open
    {
      openGap = millis() - timer;
      updateLoadCell();
    }
    digitalWrite(solenoid_pin, LOW);
    timer = millis(); // reset the timer to the time when the valve is closed
    closeGap = 0; // "closeGap" represents the amout of time in milliseconds since the valve was closed
    while(closeGap < 200 && digitalRead(close_button) == LOW) // the ratio of openGap/closeGap is equal to the theoretical percentage of thrust generated by pwm.
    {
      closeGap = millis() - timer;
      updateLoadCell();
    }
  }
  valve_state = false;
}

void checkTare(){
  // receive command from serial terminal, send 't' to initiate tare operation:
  if (Serial.available() > 0) {
    char inByte = Serial.read();
    if (inByte == 't') LoadCell.tareNoDelay();
  }

  // check if last tare operation is complete:
  if (LoadCell.getTareStatus() == true) {
    Serial.println("Tare complete");
  }
}
